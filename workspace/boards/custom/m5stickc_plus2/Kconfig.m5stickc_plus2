## workspace/boards/custom/m5stickc_plus2/Kconfig.m5stickc_plus2
```kconfig
config BOARD_M5STICKC_PLUS2
    select SOC_ESP32_PICO_V3_02
    select SOC_ESP32_PROCPU if BOARD_M5STICKC_PLUS2_ESP32_PROCPU
    select SOC_ESP32_APPCPU if BOARD_M5STICKC_PLUS2_ESP32_APPCPU
```

## workspace/boards/custom/m5stickc_plus2/board.yml
```yaml
board:
  name: m5stickc_plus2
  full_name: M5StickC PLUS2
  vendor: custom
  socs:
  - name: esp32
```

## workspace/modules/vl53l1x/drivers/vl53l1x/Kconfig
```kconfig
# VL53L0X time of flight sensor configuration options

# Copyright (c) 2023 Prosaris Solutions Inc.
# SPDX-License-Identifier: Apache-2.0

menuconfig CUSTOM_VL53L1X
	bool "VL53L1X time of flight sensor"
	default n
 	depends on DT_HAS_CUSTOM_VL53L1X_ENABLED
	select I2C
	select SENSOR
	help
	  Enable driver for VL53L1X I2C-based time of flight sensor.

if CUSTOM_VL53L1X

config CUSTOM_VL53L1X_INTERRUPT_MODE
	bool "Use interrupt mode for VL53L1X time of flight sensor"
	default y
	depends on GPIO
	help
	  Enable interrupt mode for VL53L1X time of flight sensor. Otherwise,
	  the driver will use the polling method.

config CUSTOM_VL53L1X_XSHUT
	bool "Use xshut pin on VL53L1X time of flight sensor"
	depends on GPIO
	help
	  Enable to use the xshut pin on the VL53L1X. If not, the pin should be
	  connected to VDD.

endif # CUSTOM_VL53L1X
```
